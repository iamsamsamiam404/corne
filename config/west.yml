## config/west.yml
```yaml
manifest:
  remotes:
    - name: zmkfirmware
      url-base: https://github.com/ftc/  #changed repo
  projects:
    - name: zmk
      remote: zmkfirmware
      revision: mouse-ftc  #changed revision
      import: app/west.yml
  self:
    path: config
```
